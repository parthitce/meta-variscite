## conf/layer.conf
```bitbake
# We have a conf and classes directory, append to BBPATH
BBPATH .= ":${LAYERDIR}"

# We have a recipes directory, add to BBFILES
BBFILES += "${LAYERDIR}/recipes*/*/*.bb ${LAYERDIR}/recipes*/*/*.bbappend"

BBFILE_COLLECTIONS += "variscite"
BBFILE_PATTERN_variscite := "^${LAYERDIR}/"
BBFILE_PRIORITY_variscite = "10"

# Layer dependencies
LAYERSERIES_COMPAT_variscite = "warrior master"
```

## conf/machine/include/dart-6ul.inc
```bitbake
MACHINEOVERRIDES =. "mx6:mx6ull:"
include conf/machine/include/tune-cortexa7.inc

# u-boot
PREFERRED_PROVIDER_virtual/bootloader ?= "u-boot"
PREFERRED_PROVIDER_u-boot ?= "u-boot"

UBOOT_NAME ?= "u-boot-dtb"
UBOOT_ENTRYPOINT ?= "0x87800000"
UBOOT_SUFFIX ?= "img"
SPL_BINARY ?= "SPL"
UBOOT_BINARY ?= "${UBOOT_NAME}.${UBOOT_SUFFIX}"
UBOOT_CONFIG ?= "mmc"
UBOOT_CONFIG[mmc] = "variscite_dart6ul_defconfig"

# kernel
PREFERRED_PROVIDER_virtual/kernel ?= "linux-stable"
KERNEL_DEVICETREE ?= "imx6ull-var-dart-5g-emmc_wifi.dtb"

FITLOADADDR ?= "0x82000000"
KERNEL_CLASSES += "kernel-fitimage"
KERNEL_IMAGETYPE ?= "fitImage"

SERIAL_CONSOLES ?= "115200;ttymxc0"
IMAGE_BOOT_FILES ?= "fitImage-${MACHINE}.bin;fitImage"

EXTRA_IMAGEDEPENDS += "u-boot"
IMAGE_FSTYPES ?= "ext4"
```

## wic/emmc.wks
```
part kernel0 --source bootimg-partition --ondisk mmcblk1 --fstype=vfat --label kernel0 --active --size 20
part root0 --fixed-size 200M  --align 4096 --fstype=ext4 --source rawcopy --sourceparams="file=variscite-image-base-dart-6ul-ek.ext4"

bootloader --ptable gpt
```
